#include <OS_SerialTFT.h>   //Software Serial Port
#include <SoftwareSerial.h>
#define TFT_RX 4//RX of Serial TFT module connect to D4 of Arduino / OPEN-SMART UNO
#define TFT_TX 2//TX of Serial TFT to D2
SerialTFT myTFT(TFT_RX, TFT_TX);
int touchx;
int caseis=0;


unsigned char c[]={0x00,0x00,0x00,0x00,0x00,0x00,0x00,0x00,0x00,0x80,0x00,0x10,0x00,0x84,0x00,0x10,0x00,0x87,0x00,0x08,0xC0,0x87,0x00,0x0C,0x80,0x80,0x00,0x06,0x80,0x80,0x00,0x03,
0x80,0x80,0x00,0x01,0x80,0x80,0xC0,0x00,0x80,0x80,0x60,0x00,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0x01,
0x80,0x80,0x80,0x03,0x80,0x84,0x00,0x07,0x80,0xC3,0x00,0x06,0xC0,0xC1,0x00,0x0E,0x80,0x81,0x00,0x06,0x00,0x00,0x00,0x04,0x00,0x00,0x00,0x00,0x00,0x00,0x00,0x00};


void setup() {
  // put your setup code here, to run once:
  myTFT.begin(9600);
  Serial.begin(9600);
  myTFT.reset();
  myTFT.fillScreen(BLACK);
  int i,j;
for (j = 0; j <128 ; j++) {
    for (i = 0; i < 8; i++) {
        if (c[j] & (0x80 >> i)) {
          myTFT.drawPixel((j/4)+j%4, (j%4)*8+i  , RED);
        } 
        }
    }
  Serial.print("hello");
  
}

void loop() {
  // put your main code here, to run repeatedly:
  
   
    


  
  if(myTFT.touch())
  {

    caseis=caseis+1;
   Serial.println(caseis);
  touchx=myTFT.touchX;
  myTFT.fillScreen(BLACK);

   myTFT.print(touchx);
  }
  delay(500);
}
